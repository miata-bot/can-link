## firmware/esp_fw/main/Kconfig.projbuild
```kconfig
menu "CONEPROJ Configuration"
    config CONEPROJ_USB_VID
        hex "USB vendor ID"
        default 0x4269

    config CONEPROJ_USB_PID
        hex "USB product ID"
        default 0x6969

    config CONEPROJ_MANUFACTURER
        string "USB CONEPROJ manufacturer"
        default "cone.codes"

    config CONEPROJ_PRODUCT_NAME
        string "USB product name"
        default "CONEPROJ"

endmenu
```

## firmware/esp_fw/sdkconfig.defaults
```kconfig
CONFIG_IDF_TARGET="esp32s3"
CONFIG_USB_ENABLED=y
CONFIG_USB_CDC_ENABLED=y
CONFIG_USB_MSC_ENABLED=y
CONFIG_ESP32S3_DEFAULT_CPU_FREQ_240=y
CONFIG_ESP32S3_DEFAULT_CPU_FREQ_MHZ=240
CONFIG_ESP_TASK_WDT_CHECK_IDLE_TASK_CPU0=n
CONFIG_PARTITION_TABLE_CUSTOM=y
CONFIG_PARTITION_TABLE_CUSTOM_FILENAME="partitions.csv"
CONFIG_PARTITION_TABLE_FILENAME="partitions.csv"
CONFIG_PARTITION_TABLE_OFFSET=0x8000
CONFIG_PARTITION_TABLE_MD5=y
```
